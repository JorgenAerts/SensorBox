/*

bronnen:
parts of the DHT sensor code:
https://www.instructables.com/How-to-use-DHT-22-sensor-Arduino-Tutorial/ 24/09/2024
Bluetooth code adapted from:
https://randomnerdtutorials.com/esp32-web-bluetooth/ 03/10/2024
Extra UUID's generated by:
https://www.uuidgenerator.net/ 02/10/2024
Needed help from chat gpt for the html part of the assignment
OpenAI, https://chatgpt.com  03/10/2024
Bluetooth characteristics
https://www.bluetooth.com/specifications/gatt/viewer?attributeXmlFile=org.bluetooth.descriptor.gatt.client_characteristic_configuration.xml 03/10/2024

*/

// Libraries
#include <Arduino.h>         // Arduino library
#include <DHT.h>             // temperature and humidity sensor library
#include <Adafruit_Sensor.h> // General sensor library
#include <BLEDevice.h>  // Bluetooth
#include <BLEServer.h>  // Bluetooth
#include <BLEUtils.h>  // Bluetooth
#include <BLE2902.h>  // Bluetooth

// Bluetooth

BLEServer *pServer = NULL;
BLECharacteristic *pSensorCharacteristic1 = NULL;
BLECharacteristic *pSensorCharacteristic2 = NULL;
BLECharacteristic *pSensorCharacteristic3 = NULL;
BLECharacteristic *pWritableCharacteristic1 = NULL;
bool deviceConnected = false;
bool oldDeviceConnected = false;


#define SERVICE_UUID "19b10000-e8f2-537e-4f6c-d104768a1214"
#define SENSOR_CHARACTERISTIC_UUID1 "19b10001-e8f2-537e-4f6c-d104768a1214"
#define SENSOR_CHARACTERISTIC_UUID2 "34de371c-ca75-4151-b3af-2c2d74f01a0f"
#define SENSOR_CHARACTERISTIC_UUID3 "4ebde681-8e95-4263-b9fb-7fc4030da492"
#define WRITABLE_CHARACTERISTIC_UUID1 "081ff2b0-309b-4ade-aa8f-8611ebe0d8eb"

class MyServerCallbacks : public BLEServerCallbacks
{
    void onConnect(BLEServer *pServer)
    {
        deviceConnected = true;
    };

    void onDisconnect(BLEServer *pServer)
    {
        deviceConnected = false;
    }
};

class MyCallbacks : public BLECharacteristicCallbacks {
    void onWrite(BLECharacteristic *pCharacteristic) {
        std::string value = pCharacteristic->getValue();
        if (value == "1")
        std::string value = pCharacteristic->getValue();
        if (value.length() > 0) {
            Serial.println("Received data from web app:");
            for (int i = 0; i < value.length(); i++) {
                Serial.print(value[i]);
            }
            Serial.println();
        }
    }
};

// leds
#define ledRedLum 25    // Indication led for optimal luminosity
#define ledRedTemp 26   // Indication led for optimal temperature
#define ledRedHum 14    // Indication led for optimal humidity
#define ledGreenLum 13  // Indication led for suboptimal luminosity
#define ledGreenTemp 21 // Indication led for suboptimal temperature
#define ledGreenHum 22  // Indication led for suboptimal humidity

// Lichtsensor
#define ldrSensor 36
int lum = 0; // Stores ldr sensor value (luminosity)
unsigned long previousMillisLdr = 0;
const long intervalLdr = 5000; // Interval of 5 seconds for ldr readout

// DHT 22 sensor (temperature and humidity)
#define DHTPIN 16         // What digital pin we're connected to
#define DHTTYPE DHT22     // DHT 22  (AM2302)
DHT dht(DHTPIN, DHTTYPE); // Initialize DHT sensor
float hum;                // Stores humidity value
float temp;               // Stores temperature value
unsigned long previousMillisDht = 0;
const long intervalDht = 5000; // Interval of 5 seconds for dht sensor reading

// Button
#define buttonRead 19
unsigned long previousMillisButton = 0;
const long intervalButton = 300;

void setup()
{
    Serial.begin(9600);                       // Start serial monitor
    Serial.println("Serial monitor started"); // Debug message
    dht.begin();                              // Start dht
    BLEDevice::init("SensorBoxOne");          // Creates the 'SensorBoxOne' bluetooth device

    // Create the BLE Server
    pServer = BLEDevice::createServer();
    pServer->setCallbacks(new MyServerCallbacks());

    // Create the BLE Service
    BLEService *pService = pServer->createService(SERVICE_UUID);

    // Create BLE Characteristics
    // 1 for luminosity
    pSensorCharacteristic1 = pService->createCharacteristic(
        SENSOR_CHARACTERISTIC_UUID1,
            BLECharacteristic::PROPERTY_READ |
            BLECharacteristic::PROPERTY_WRITE |
            BLECharacteristic::PROPERTY_NOTIFY |
            BLECharacteristic::PROPERTY_INDICATE);
    // 2 for Temperature
    pSensorCharacteristic2 = pService->createCharacteristic(
        SENSOR_CHARACTERISTIC_UUID2,
            BLECharacteristic::PROPERTY_READ |
            BLECharacteristic::PROPERTY_WRITE |
            BLECharacteristic::PROPERTY_NOTIFY |
            BLECharacteristic::PROPERTY_INDICATE);
    // 3 for Humidity
    pSensorCharacteristic3 = pService->createCharacteristic(
        SENSOR_CHARACTERISTIC_UUID3,
            BLECharacteristic::PROPERTY_READ |
            BLECharacteristic::PROPERTY_WRITE |
            BLECharacteristic::PROPERTY_NOTIFY |
            BLECharacteristic::PROPERTY_INDICATE);
    // 4 for receiving data from webapp
    pWritableCharacteristic1 = pService->createCharacteristic(
        WRITABLE_CHARACTERISTIC_UUID1,
            BLECharacteristic::PROPERTY_READ |
            BLECharacteristic::PROPERTY_WRITE |
            BLECharacteristic::PROPERTY_NOTIFY |
            BLECharacteristic::PROPERTY_INDICATE);

    pWritableCharacteristic1->setCallbacks(new MyCallbacks());

    // https://www.bluetooth.com/specifications/gatt/viewer?attributeXmlFile=org.bluetooth.descriptor.gatt.client_characteristic_configuration.xml
    // Create a BLE Descriptor
    pSensorCharacteristic1->addDescriptor(new BLE2902());
    pSensorCharacteristic2->addDescriptor(new BLE2902());
    pSensorCharacteristic3->addDescriptor(new BLE2902());
    pWritableCharacteristic1->addDescriptor(new BLE2902());

    // Start the service
    pService->start();

    // Start advertising
    BLEAdvertising *pAdvertising = BLEDevice::getAdvertising();
    pAdvertising->addServiceUUID(SERVICE_UUID);
    pAdvertising->setScanResponse(false);
    pAdvertising->setMinPreferred(0x0); // set value to 0x00 to not advertise this parameter
    BLEDevice::startAdvertising();
    Serial.println("Waiting a client connection to notify...");

    // Input/Output
    pinMode(ledRedLum, OUTPUT);
    pinMode(ledRedTemp, OUTPUT);
    pinMode(ledRedHum, OUTPUT);
    pinMode(ledGreenLum, OUTPUT);
    pinMode(ledGreenTemp, OUTPUT);
    pinMode(ledGreenHum, OUTPUT);
    pinMode(buttonRead, INPUT);
}

void readLdr()
{
    // Print LDR value to serial monitor (this is for testing only)
    unsigned long currentMillisLdr = millis();

    if (currentMillisLdr - previousMillisLdr >= intervalLdr)
    {
        lum = (analogRead(ldrSensor));
        Serial.print("LDR waarde: ");
        Serial.print(lum);
        Serial.println("");

        previousMillisLdr = currentMillisLdr;
    }
}
void readDht()
{
    unsigned long currentMillisDht = millis(); // Saves the current time

    if (currentMillisDht - previousMillisDht >= intervalDht) // Delay so the temperature is only measured every second
    {
        // Reading temperature or humidity takes about 250 milliseconds!
        // Sensor readings may also be up to 2 seconds 'old' (its a very slow sensor)
        hum = dht.readHumidity();     // Read humidity
        temp = dht.readTemperature(); // Read temperature as Celsius

        // Check if any reads failed and exit early (to try again).
        if (isnan(hum) || isnan(temp))
        {
            Serial.println("Failed to read from DHT sensor!");
            return;
        }
        // Print humidity and temperature values to serial monitor (this is for testing only)
        Serial.print("Humidity: ");
        Serial.print(hum);
        Serial.print(" %, Temp: ");
        Serial.print(temp);
        Serial.println(" Celsius");

        previousMillisDht = currentMillisDht;
    }
}

void indicateStatus()
{
    // Humidity indicator
    if (hum >= 85) // Optimal humidity is above 85 percent
    {
        digitalWrite(ledGreenHum, HIGH);
        digitalWrite(ledRedHum, LOW); // Turn off the red LED when green is ON
    }
    else
    {
        digitalWrite(ledGreenHum, LOW); // Turn off the green LED when red is ON
        digitalWrite(ledRedHum, HIGH);
    }

    // Temperature indicator
    if (temp < 19 || temp > 23) // Optimal temperature for mycelium growth is 21°C
    // if (temp < 12 && temp > 16) // Optimal temperature for mushroom growth is 13 to 15°C
    {
        digitalWrite(ledRedTemp, HIGH);
        digitalWrite(ledGreenTemp, LOW);
    }
    else
    {
        digitalWrite(ledGreenTemp, HIGH);
        digitalWrite(ledRedTemp, LOW);
    }

    // Light intensity indicator
    if (lum <= 1500)
    {
        digitalWrite(ledGreenLum, HIGH);
        digitalWrite(ledRedLum, LOW);
    }
    else
    {
        digitalWrite(ledGreenLum, LOW);
        digitalWrite(ledRedLum, HIGH);
    }
}

void readButton()
{
    unsigned long currentMillisButton = millis();
    if (currentMillisButton - previousMillisButton >= intervalButton)
    {
        if (digitalRead(buttonRead) == HIGH)
        {
            Serial.print("Humidity: ");
            Serial.print(hum);
            Serial.print(" %, Temp: ");
            Serial.print(temp);
            Serial.println(" Celsius");

            previousMillisButton = currentMillisButton;
        }
    }
}

void writeToBle()
{
    // notify changed value
    if (deviceConnected)
    {
        pSensorCharacteristic1->setValue(String(lum).c_str());
        pSensorCharacteristic1->notify();
        delay(30); // bluetooth stack will go into congestion, if too many packets are sent, in 6 hours test i was able to go as low as 3ms
       
        pSensorCharacteristic2->setValue(String(temp).c_str());
        pSensorCharacteristic2->notify();
        delay(30); // bluetooth stack will go into congestion, if too many packets are sent, in 6 hours test i was able to go as low as 3ms
      
        pSensorCharacteristic3->setValue(String(hum).c_str());
        pSensorCharacteristic3->notify();
        delay(30); // bluetooth stack will go into congestion, if too many packets are sent, in 6 hours test i was able to go as low as 3ms
    }
    // disconnecting
    if (!deviceConnected && oldDeviceConnected)
    {
        Serial.println("Device disconnected.");
        delay(500);                  // give the bluetooth stack the chance to get things ready
        pServer->startAdvertising(); // restart advertising
        Serial.println("Start advertising");
        oldDeviceConnected = deviceConnected;
    }
    // connecting
    if (deviceConnected && !oldDeviceConnected)
    {
        // do stuff here on connecting
        oldDeviceConnected = deviceConnected;
        Serial.println("Device Connected");
    }
}

void loop()
{
    readDht();
    readLdr();
    indicateStatus();
    readButton();
    writeToBle();
}
